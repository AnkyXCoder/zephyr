## boards/espressif/esp32s3_touch_lcd/Kconfig
```kconfig
# Copyright (c) 2025 iNode
# SPDX-License-Identifier: Apache-2.0

config HEAP_MEM_POOL_ADD_SIZE_BOARD
	int
	default 4096 if BOARD_ESP32S3_TOUCH_LCD_ESP32S3_PROCPU
	default 256 if BOARD_ESP32S3_TOUCH_LCD_ESP32S3_APPCPU
```

## boards/espressif/esp32s3_touch_lcd/Kconfig.esp32s3_touch_lcd
```kconfig
# Copyright (c) 2025 iNode
# SPDX-License-Identifier: Apache-2.0

config BOARD_ESP32S3_TOUCH_LCD
	select SOC_ESP32S3_R2
	select SOC_ESP32S3_PROCPU if BOARD_ESP32S3_TOUCH_LCD_ESP32S3_PROCPU
	select SOC_ESP32S3_APPCPU if BOARD_ESP32S3_TOUCH_LCD_ESP32S3_APPCPU
```

## drivers/adc/Kconfig.ads7142
```kconfig
# Copyright (c) 2023
#
# SPDX-License-Identifier: Apache-2.0

config ADC_ADS7142
	bool "Texas instruments ADS7142 I2C"
	default y
	depends on DT_HAS_TI_ADS7142_ENABLED
	select I2C
	select ADC_CONFIGURABLE_INPUTS
	help
	  Enable the driver implementation for the ADS7142

if ADC_ADS7142

config ADC_ADS7142_INIT_PRIORITY
	int "ADS7142 init priority"
	default 80
	help
	  ADS7142 device initialization priority must come
	  after I2C initialization

config ADC_ADS7142_ACQUISITION_THREAD_STACK_SIZE
	int "Stack size for the ADC data acquisition thread"
	default 512
	help
	  Size of the stack used for the internal data acquisition
	  thread.

config ADC_ADS7142_ACQUISITION_THREAD_PRIO
	int "Priority for the ADC data acquisition thread"
	default 0
	help
	  Priority level for the internal ADC data acquisition thread.

endif # ADC_ADS7142
```

## dts/bindings/adc/ti,ads7142.yaml
```yaml
# Copyright (c) 2023, Google LLC
# SPDX-License-Identifier: Apache-2.0

description: Texas Instrument Single Channel I2C ADC

compatible: "ti,ads7142"

include: [adc-controller.yaml, i2c-device.yaml]

on-bus: i2c

properties:
  "#io-channel-cells":
    const: 2

io-channel-cells:
  - input
```

## dts/bindings/charger/ti,bq25601.yaml
```yaml
# Copyright 2025 Ankitkumar Modi
# SPDX-License-Identifier: Apache-2.0

description: |
  BQ25601 I2C battery charge controller IC.

  BQ25601 targets 1-Cell 3-A Buck Battery Charger for High Input Voltage and
  NVDC Power Path Management

  This charger is represented by device tree child node, e.g:

  charger: bq25601@6b {
      compatible = "ti,bq25601";
      reg = <0x6b>;
      status = "okay";

      constant-charge-current-max-microamp = <1000000>;
      constant-charge-voltage-max-microvolt = <4352000>;
      system-voltage-min-threshold-microvolt = <3500000>;
  };

include: [battery.yaml, i2c-device.yaml]

compatible: "ti,bq25601"

properties:
  constant-charge-current-max-microamp:
    required: true
    description: |
      The charge current target for the constant current phase of the charge profile.
      This value will be set at initialization time. Range: 100 mA to 3200 mA.
      The value specified will be rounded down to the closest implemented value.

  constant-charge-voltage-max-microvolt:
    required: true
    description: |
      The voltage regulation target for the constant voltage phase of the battery charging profile.
      This value will be set at initialization time. Range: 3.856 V to 4.624 V.
      The value specified will be rounded down to the closest implemented value.

  system-voltage-min-threshold-microvolt:
    type: int
    required: true
    description: |
      Minimum system voltage.
      Voltage that will be set above when the system voltage drops this level.
      This value will be set at initialization time. Range: 2.6 V to 3.7 V.
      The value specified will be rounded down to the closest implemented value.
```

## dts/bindings/sensor/azoteq,iqs621.yaml
```yaml
# Copyright(c) 2018, Ankitkumar Modi
# SPDX-License-Identifier: Apache-2.0

description: IQS621 ambient light, temperature monitoring

compatible: "azoteq,iqs621"

include: [sensor-device.yaml, i2c-device.yaml]

properties:
  int-gpios:
    type: phandle-array
    description: Interrupt pin.

      The interrupt pin of IQS621 is open-drain, active low
      and indicates a communication window.

  multiplier-coarse:
    type: int
    required: true
    description: |
      Select the ALS Setting - Coarse Multiplier value.
      Default value is chosen from the official documentation.
      - <IQS621_MULTIPLIER_COARSE_3>:  3
      - <IQS621_MULTIPLIER_COARSE_2>:  2
      - <IQS621_MULTIPLIER_COARSE_1>:  1
      - <IQS621_MULTIPLIER_COARSE_0>:  0
    default: 0
    enum:
      - 3
      - 2
      - 1
      - 0

  multiplier-fine:
    type: int
    required: true
    description: |
      Select the ALS Setting - Fine Multiplier value.
      Default value is chosen from the official documentation.
      - <IQS621_MULTIPLIER_FINE_15>:  15
      - <IQS621_MULTIPLIER_FINE_14>:  14
      - <IQS621_MULTIPLIER_FINE_13>:  13
      - <IQS621_MULTIPLIER_FINE_12>:  12
      - <IQS621_MULTIPLIER_FINE_11>:  11
      - <IQS621_MULTIPLIER_FINE_10>:  10
      - <IQS621_MULTIPLIER_FINE_9>:  9
      - <IQS621_MULTIPLIER_FINE_8>:  8
      - <IQS621_MULTIPLIER_FINE_7>:  7
      - <IQS621_MULTIPLIER_FINE_6>:  6
      - <IQS621_MULTIPLIER_FINE_5>:  5
      - <IQS621_MULTIPLIER_FINE_4>:  4
      - <IQS621_MULTIPLIER_FINE_3>:  3
      - <IQS621_MULTIPLIER_FINE_2>:  2
      - <IQS621_MULTIPLIER_FINE_1>:  1
      - <IQS621_MULTIPLIER_FINE_0>:  0
    default: 0
    enum:
      - 15
      - 14
      - 13
      - 12
      - 11
      - 10
      - 9
      - 8
      - 7
      - 6
      - 5
      - 4
      - 3
      - 2
      - 1
      - 0
```

## dts/bindings/sensor/vishay,vcnl4010.yaml
```yaml
# Copyright (c) 2020 Ankitkumar Modi
# SPDX-License-Identifier: Apache-2.0

description: |
  VCNL4010 proximity and ambient light sensor.  See datasheet at
  https://www.vishay.com/docs/84138/designingvcnl4010.pdf

compatible: "vishay,vcnl4010"

include: [sensor-device.yaml, i2c-device.yaml]

properties:
  int-gpios:
    type: phandle-array
    description: |
      The INT pin signals that a programmable interrupt function
      for ALS and PS with upper and lower thresholds has been
      triggered. The sensor generates an active-low level signal
      which remains asserted until the data is read.

  led-current:
    type: int
    default: 20
    # default of 20 mA is IR LED Current POR (0b00010) for IR LED CURRENT register
    description: LED current in mA
    enum:
      - 0
      - 10
      - 20
      - 30
      - 40
      - 50
      - 60
      - 70
      - 80
      - 90
      - 100
      - 110
      - 120
      - 130
      - 140
      - 150
      - 160
      - 170
      - 180
      - 190
      - 200

  proximity-rate:
    type: string
    default: "1.95"
    # default of 1.95 is POR (0b000) for PROXIMITY RATE register
    description: Proximity Measurement Rate in measurements per second
    enum:
      - "1.95"
      - "3.90625"
      - "7.8125"
      - "16.625"
      - "31.25"
      - "62.5"
      - "125"
      - "250"

  proximity-trigger:
    type: string
    default: "disabled"
    # default of "disabled" is POR (0b00) for PS_CONF2[PS_INT] register
    description: Proximity trigger type
    enum:
      - "disabled"
      - "close"
      - "away"
      - "close-away"

  als-it:
    type: int
    default: 80
    # default of 80 is POR (0b00) for ALS_CONF[ALS_IT] register
    description: ALS integration time in ms
    enum:
      - 80
      - 160
      - 320
      - 640
```
