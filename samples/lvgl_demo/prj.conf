## CMakeLists.txt
```
# Copyright (c) 2023 Fabian Blatz <fabianblatz@gmail.com>
# SPDX-License-Identifier: Apache-2.0

cmake_minimum_required(VERSION 3.20.0)

find_package(Zephyr REQUIRED HINTS $ENV{ZEPHYR_BASE})
project(lvgl_sample)

set(LVGL_DIR ${ZEPHYR_LVGL_MODULE_DIR})

FILE(GLOB app_sources src/*.c)
target_sources(app PRIVATE ${app_sources})

target_include_directories(app PRIVATE
    ${CMAKE_CURRENT_SOURCE_DIR}/src/
)

target_include_directories(app PRIVATE
    ${LVGL_DIR}/demos/
)

target_sources_ifdef(CONFIG_LV_USE_DEMO_MUSIC app PRIVATE
    ${LVGL_DIR}/demos/music/lv_demo_music_list.c
    ${LVGL_DIR}/demos/music/lv_demo_music.c
    ${LVGL_DIR}/demos/music/lv_demo_music_main.c
    ${LVGL_DIR}/demos/music/assets/img_lv_demo_music_btn_next.c
    ${LVGL_DIR}/demos/music/assets/img_lv_demo_music_wave_top_large.c
    ${LVGL_DIR}/demos/music/assets/img_lv_demo_music_icon_4_large.c
    ${LVGL_DIR}/demos/music/assets/img_lv_demo_music_icon_4.c
    ${LVGL_DIR}/demos/music/assets/img_lv_demo_music_corner_right.c
    ${LVGL_DIR}/demos/music/assets/img_lv_demo_music_cover_1.c
    ${LVGL_DIR}/demos/music/assets/img_lv_demo_music_slider_knob_large.c
    ${LVGL_DIR}/demos/music/assets/img_lv_demo_music_icon_3.c
    ${LVGL_DIR}/demos/music/assets/img_lv_demo_music_btn_pause.c
    ${LVGL_DIR}/demos/music/assets/img_lv_demo_music_btn_pause_large.c
    ${LVGL_DIR}/demos/music/assets/img_lv_demo_music_wave_bottom_large.c
    ${LVGL_DIR}/demos/music/assets/img_lv_demo_music_icon_2_large.c
    ${LVGL_DIR}/demos/music/assets/img_lv_demo_music_btn_list_play_large.c
    ${LVGL_DIR}/demos/music/assets/img_lv_demo_music_wave_top.c
    ${LVGL_DIR}/demos/music/assets/img_lv_demo_music_btn_play_large.c
    ${LVGL_DIR}/demos/music/assets/img_lv_demo_music_cover_1_large.c
    ${LVGL_DIR}/demos/music/assets/img_lv_demo_music_wave_bottom.c
    ${LVGL_DIR}/demos/music/assets/img_lv_demo_music_corner_left_large.c
    ${LVGL_DIR}/demos/music/assets/img_lv_demo_music_btn_play.c
    ${LVGL_DIR}/demos/music/assets/img_lv_demo_music_list_border.c
    ${LVGL_DIR}/demos/music/assets/img_lv_demo_music_icon_2.c
    ${LVGL_DIR}/demos/music/assets/img_lv_demo_music_btn_next_large.c
    ${LVGL_DIR}/demos/music/assets/img_lv_demo_music_btn_list_play.c
    ${LVGL_DIR}/demos/music/assets/img_lv_demo_music_list_border_large.c
    ${LVGL_DIR}/demos/music/assets/img_lv_demo_music_btn_rnd.c
    ${LVGL_DIR}/demos/music/assets/img_lv_demo_music_cover_3.c
    ${LVGL_DIR}/demos/music/assets/img_lv_demo_music_btn_prev_large.c
    ${LVGL_DIR}/demos/music/assets/img_lv_demo_music_btn_loop.c
    ${LVGL_DIR}/demos/music/assets/img_lv_demo_music_icon_1.c
    ${LVGL_DIR}/demos/music/assets/img_lv_demo_music_slider_knob.c
    ${LVGL_DIR}/demos/music/assets/img_lv_demo_music_corner_right_large.c
    ${LVGL_DIR}/demos/music/assets/img_lv_demo_music_btn_corner_large.c
    ${LVGL_DIR}/demos/music/assets/img_lv_demo_music_corner_left.c
    ${LVGL_DIR}/demos/music/assets/img_lv_demo_music_cover_2_large.c
    ${LVGL_DIR}/demos/music/assets/img_lv_demo_music_icon_3_large.c
    ${LVGL_DIR}/demos/music/assets/img_lv_demo_music_icon_1_large.c
    ${LVGL_DIR}/demos/music/assets/img_lv_demo_music_cover_2.c
    ${LVGL_DIR}/demos/music/assets/img_lv_demo_music_btn_prev.c
    ${LVGL_DIR}/demos/music/assets/img_lv_demo_music_btn_rnd_large.c
    ${LVGL_DIR}/demos/music/assets/img_lv_demo_music_btn_list_pause_large.c
    ${LVGL_DIR}/demos/music/assets/img_lv_demo_music_cover_3_large.c
    ${LVGL_DIR}/demos/music/assets/img_lv_demo_music_btn_list_pause.c
    ${LVGL_DIR}/demos/music/assets/img_lv_demo_music_logo.c
    ${LVGL_DIR}/demos/music/assets/img_lv_demo_music_btn_loop_large.c
)

target_sources_ifdef(CONFIG_LV_USE_DEMO_BENCHMARK app PRIVATE
    ${LVGL_DIR}/demos/benchmark/lv_demo_benchmark.c
    ${LVGL_DIR}/demos/benchmark/assets/img_benchmark_cogwheel_indexed16.c
    ${LVGL_DIR}/demos/benchmark/assets/lv_font_bechmark_montserrat_28_compr_az.c.c
    ${LVGL_DIR}/demos/benchmark/assets/lv_font_bechmark_montserrat_16_compr_az.c.c
    ${LVGL_DIR}/demos/benchmark/assets/img_benchmark_cogwheel_argb.c
    ${LVGL_DIR}/demos/benchmark/assets/img_benchmark_cogwheel_alpha16.c
    ${LVGL_DIR}/demos/benchmark/assets/img_benchmark_cogwheel_rgb.c
    ${LVGL_DIR}/demos/benchmark/assets/lv_font_bechmark_montserrat_12_compr_az.c.c
    ${LVGL_DIR}/demos/benchmark/assets/img_benchmark_cogwheel_chroma_keyed.c
    ${LVGL_DIR}/demos/benchmark/assets/img_benchmark_cogwheel_rgb565a8.c
)

target_sources_ifdef(CONFIG_LV_USE_DEMO_STRESS app PRIVATE
    ${LVGL_DIR}/demos/stress/lv_demo_stress.c
)

target_sources_ifdef(CONFIG_LV_USE_DEMO_WIDGETS app PRIVATE
    ${LVGL_DIR}/demos/widgets/assets/img_clothes.c
    ${LVGL_DIR}/demos/widgets/assets/img_demo_widgets_avatar.c
    ${LVGL_DIR}/demos/widgets/assets/img_lvgl_logo.c
    ${LVGL_DIR}/demos/widgets/lv_demo_widgets.c
)
```

## Kconfig
```
# Copyright (c) 2023 Fabian Blatz <fabianblatz@gmail.com>
# SPDX-License-Identifier: Apache-2.0

choice LV_Z_DEMO
	prompt "LVGL demo to build"
	default LV_USE_DEMO_SAMPLE
	help
	  Demo application to build.

config LV_Z_DEMO_MUSIC
	bool "LVGL music demo"
	select LV_USE_DEMO_MUSIC
	help
	  Build music player demo application.

config LV_Z_DEMO_BENCHMARK
	bool "LVGL benchmark demo"
	select LV_USE_DEMO_BENCHMARK
	help
	  Build benchmarking demo application.

config LV_Z_DEMO_STRESS
	bool "LVGL stress demo"
	select LV_USE_DEMO_STRESS
	help
	  Build stress testing demo application.

config LV_Z_DEMO_WIDGETS
	bool "LVGL widgets demo"
	select LV_USE_DEMO_WIDGETS
	help
	  Build stress testing demo application.

config LV_Z_DEMO_SAMPLE
	bool "LVGL sample demo"
	select LV_USE_DEMO_SAMPLE
	help
	  Build sample testing demo application.

endchoice

source "Kconfig.zephyr"
```

## sample.yaml
```
sample:
  description: LVGL sample, containing all upstream demos
  name: LVGL demos
common:
  modules:
    - lvgl
  harness: none
  filter: dt_chosen_enabled("zephyr,display")
  tags:
    - samples
    - display
    - lvgl
    - gui
tests:
  sample.modules.lvgl.demo_music:
    extra_configs:
      - CONFIG_LV_Z_DEMO_MUSIC=y
  sample.modules.lvgl.demo_benchmark:
    extra_configs:
      - CONFIG_LV_Z_DEMO_BENCHMARK=y
  sample.modules.lvgl.demo_stress:
    extra_configs:
      - CONFIG_LV_Z_DEMO_STRESS=y
  sample.modules.lvgl.demo_widgets:
    extra_configs:
      - CONFIG_LV_Z_DEMO_WIDGETS=y
```

## prj.conf
```kconfig
CONFIG_MAIN_STACK_SIZE=4096
CONFIG_LOG=y
CONFIG_LOG_MODE_IMMEDIATE=y
CONFIG_SHELL=y

CONFIG_LVGL=y
CONFIG_LV_Z_MEM_POOL_SIZE=49152
CONFIG_LV_Z_SHELL=y
CONFIG_LV_USE_MONKEY=y

CONFIG_DISPLAY=y
CONFIG_INPUT=y
CONFIG_INPUT_CST816S_INTERRUPT=y

CONFIG_REGULATOR=y
CONFIG_ENTROPY_GENERATOR=y
CONFIG_KERNEL_MEM_POOL=y

CONFIG_GPIO=y
CONFIG_I2C=y
CONFIG_PWM=y

CONFIG_LV_COLOR_16_SWAP=y

CONFIG_LV_FONT_MONTSERRAT_12=y
CONFIG_LV_FONT_MONTSERRAT_14=y
CONFIG_LV_FONT_MONTSERRAT_16=y

# Benchmark Demo
CONFIG_LV_USE_FONT_COMPRESSED=y

CONFIG_SHELL=y
```

## src/main.c
```c
#include <zephyr/drivers/display.h>
#include <zephyr/drivers/pwm.h>
#include <zephyr/kernel.h>

#include <lv_demos.h>
#include <lvgl.h>

#include "lv_sample.h"

#define LOG_LEVEL CONFIG_LOG_DEFAULT_LEVEL
#include <zephyr/logging/log.h>
LOG_MODULE_REGISTER(app);

static const struct pwm_dt_spec pwm_led0 = PWM_DT_SPEC_GET(DT_ALIAS(pwm_lcd0));
#define MAX_PERIOD (1 * 1000 * 100) // This is equivalent to 0.1 msec time period (1kHz frequency)

int main(void)
{
	const struct device *display_dev;

	display_dev = DEVICE_DT_GET(DT_CHOSEN(zephyr_display));
	if (!device_is_ready(display_dev)) {
		LOG_ERR("Device not ready, aborting test");
		return 0;
	}

	if (!pwm_is_ready_dt(&pwm_led0)) {
		LOG_ERR("PWM device not ready, aborting test");
		return 0;
	}

	uint32_t pulse_width = MAX_PERIOD;
	/* configure the PWM Pulse Period and Pulse Width */
	pwm_set_dt(&pwm_led0, MAX_PERIOD, pulse_width);

#if defined(CONFIG_LV_USE_DEMO_MUSIC)
	lv_demo_music();
#elif defined(CONFIG_LV_USE_DEMO_BENCHMARK)
	lv_demo_benchmark();
#elif defined(CONFIG_LV_USE_DEMO_STRESS)
	lv_demo_stress();
#elif defined(CONFIG_LV_USE_DEMO_WIDGETS)
	lv_demo_widgets();
#elif defined(CONFIG_LV_USE_DEMO_SAMPLE)
	lv_demo_sample();
#else
#error Enable one of the demos CONFIG_LV_USE_DEMO_MUSIC, CONFIG_LV_USE_DEMO_BENCHMARK ,\
	CONFIG_LV_USE_DEMO_STRESS, or CONFIG_LV_USE_DEMO_WIDGETS
#endif

	lv_task_handler();
	display_blanking_off(display_dev);

	uint32_t count = 10, iteration = 0;
	while (1) {
		k_msleep(lv_task_handler());

		if ((iteration % 1000) == 0) {
			pulse_width = (MAX_PERIOD * count) / 10;
			count--;
			if (count == 0) {
				count = 10;
			}

			LOG_INF("PWM Pulse Period: %d, PWM Pulse Width: %d", MAX_PERIOD,
				pulse_width);
		}
		iteration++;
		pwm_set_dt(&pwm_led0, MAX_PERIOD, pulse_width);
	}

	return 0;
}
```

## src/lvgl_sample.c
```c
#include <lvgl.h>

static lv_obj_t *meter;

static void set_value(void *indic, int32_t v)
{
	lv_meter_set_indicator_end_value(meter, indic, v);
}

/**
 * A meter with multiple arcs
 */
static void lv_example_meter_2(void)
{
	meter = lv_meter_create(lv_scr_act());
	lv_obj_center(meter);
	lv_obj_set_size(meter, 200, 200);

	/*Remove the circle from the middle*/
	lv_obj_remove_style(meter, NULL, LV_PART_INDICATOR);

	/*Add a scale first*/
	lv_meter_scale_t *scale = lv_meter_add_scale(meter);
	lv_meter_set_scale_ticks(meter, scale, 11, 2, 10, lv_palette_main(LV_PALETTE_GREY));
	lv_meter_set_scale_major_ticks(meter, scale, 1, 2, 30, lv_color_hex3(0xeee), 15);
	lv_meter_set_scale_range(meter, scale, 0, 100, 270, 90);

	/*Add a three arc indicator*/
	lv_meter_indicator_t *indic1 =
		lv_meter_add_arc(meter, scale, 10, lv_palette_main(LV_PALETTE_RED), 0);
	lv_meter_indicator_t *indic2 =
		lv_meter_add_arc(meter, scale, 10, lv_palette_main(LV_PALETTE_GREEN), -10);
	lv_meter_indicator_t *indic3 =
		lv_meter_add_arc(meter, scale, 10, lv_palette_main(LV_PALETTE_BLUE), -20);

	/*Create an animation to set the value*/
	lv_anim_t a;
	lv_anim_init(&a);
	lv_anim_set_exec_cb(&a, set_value);
	lv_anim_set_values(&a, 0, 100);
	lv_anim_set_repeat_delay(&a, 100);
	lv_anim_set_playback_delay(&a, 100);
	lv_anim_set_repeat_count(&a, LV_ANIM_REPEAT_INFINITE);

	lv_anim_set_time(&a, 2000);
	lv_anim_set_playback_time(&a, 500);
	lv_anim_set_var(&a, indic1);
	lv_anim_start(&a);

	lv_anim_set_time(&a, 1000);
	lv_anim_set_playback_time(&a, 1000);
	lv_anim_set_var(&a, indic2);
	lv_anim_start(&a);

	lv_anim_set_time(&a, 1000);
	lv_anim_set_playback_time(&a, 2000);
	lv_anim_set_var(&a, indic3);
	lv_anim_start(&a);
}

void lv_demo_sample(void)
{
	lv_example_meter_2();
}
```

## src/lvgl_sample.h
```c
#ifndef LVGL_SAMPLE_H
#define LVGL_SAMPLE_H

void lv_demo_sample(void);

#endif
```
